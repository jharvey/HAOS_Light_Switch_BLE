## CMakeLists.txt
```
# Copyright (c) 2026 Nordic Semiconductor ASA
# SPDX-License-Identifier: LicenseRef-Nordic-5-Clause

cmake_minimum_required(VERSION 3.20.0)

find_package(Zephyr REQUIRED HINTS $ENV{ZEPHYR_BASE})
project(Serial_hellow_world)

# Use your local main.c instead of the sample's directory
target_sources(app PRIVATE src/main.c)
```

## prj.conf
```kconfig
# Enable Zephyr Logging
CONFIG_LOG=y

# Enable SWO as the logging backend
CONFIG_LOG_BACKEND_SWO=y

# Set SWO speed (standard for nRF52 is 2MHz)
CONFIG_LOG_BACKEND_SWO_FREQ_HZ=2000000
```

## app.overlay
```dts
/ {
    aliases {
        led0 = &green_led;
    };

    leds {
        compatible = "gpio-leds";
        green_led: led_0 {
            gpios = <&gpio0 8 GPIO_ACTIVE_LOW>;
            label = "Green LED";
        };
    };
};
```

## src/main.c
```c
#include <zephyr/logging/log.h>

// Register the log module for this file
LOG_MODULE_REGISTER(my_app, LOG_LEVEL_INF);

int main(void) {
    // ... your existing LED setup code ...

    while (1) {
        LOG_INF("Hello World");
        // ... your existing LED blink code ...
        k_msleep(1000);
    }
}
```
